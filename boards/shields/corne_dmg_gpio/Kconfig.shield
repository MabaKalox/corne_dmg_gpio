## boards/shields/corne_dmg_gpio/Kconfig.shield
```kconfig
# Copyright (c) 2020 Pete Johanson
# SPDX-License-Identifier: MIT

config SHIELD_CORNE_DMG_GPIO_LEFT
    def_bool $(shields_list_contains,corne_dmg_gpio_left)

config SHIELD_CORNE_DMG_GPIO_RIGHT
    def_bool $(shields_list_contains,corne_dmg_gpio_right)
```
